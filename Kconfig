## Kconfig
```kconfig
# SPDX-License-Identifier: GPL-2.0
#
# For a description of the syntax of this configuration file,
# see Documentation/kbuild/kconfig-language.txt.
#
mainmenu "Linux/$ARCH $KERNELVERSION Kernel Configuration"

config SRCARCH
	string
	option env="SRCARCH"

config EXFAT_FS
	tristate "exFAT filesystem support"
	select BUFFER_HEAD
	select NLS
	select LEGACY_DIRECT_IO
	help
	  This allows you to mount devices formatted with the exFAT file system.
	  exFAT is typically used on SD-Cards or USB sticks.

source "arch/$SRCARCH/Kconfig"
```
